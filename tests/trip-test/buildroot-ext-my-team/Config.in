## tests/trip-test/buildroot-ext-my-team/configs/my_team_product_x86_64_main_defconfig
```kconfig
BR2_x86_64=y
BR2_TOOLCHAIN_EXTERNAL=y
BR2_TOOLCHAIN_EXTERNAL_DOWNLOAD=y
BR2_TOOLCHAIN_EXTERNAL_URL="file://$(BR2_DL_DIR)/buildroot-xctc/$(ARCH)-buildroot-linux-gnu_sdk-buildroot.tar.gz"
BR2_TOOLCHAIN_EXTERNAL_GCC_9=y
BR2_TOOLCHAIN_EXTERNAL_HEADERS_5_4=y
BR2_TOOLCHAIN_EXTERNAL_CUSTOM_GLIBC=y
BR2_ROOTFS_SKELETON_CUSTOM=y
BR2_ROOTFS_SKELETON_CUSTOM_PATH="$(BR2_EXTERNAL_MY_TEAM_PATH)/board/my-team/my-product/rootfs-skeleton"
BR2_INIT_NONE=y
BR2_ROOTFS_DEVICE_TABLE="system/device_table.txt $(BR2_EXTERNAL_MY_TEAM_PATH)/board/my-team/my-product/devices.table.txt"
BR2_ROOTFS_DEVICE_TABLE_SUPPORTS_EXTENDED_ATTRIBUTES=y
BR2_ROOTFS_MERGED_USR=y
BR2_SYSTEM_DEFAULT_PATH="/bin:/sbin:/usr/bin:/usr/sbin"
BR2_ROOTFS_USERS_TABLES="$(BR2_EXTERNAL_MY_TEAM_PATH)/board/my-team/my-product/users.table.txt"
BR2_ROOTFS_POST_BUILD_SCRIPT="$(BR2_EXTERNAL_MY_TEAM_PATH)/board/my-team/my-product/buildroot-hook.post-build.sh"
BR2_ROOTFS_POST_FAKEROOT_SCRIPT="$(BR2_EXTERNAL_MY_TEAM_PATH)/board/my-team/my-product/buildroot-hook.post-fakeroot.sh"
BR2_ROOTFS_POST_IMAGE_SCRIPT="$(BR2_EXTERNAL_MY_TEAM_PATH)/board/my-team/my-product/buildroot-hook.post-image.sh"
BR2_LINUX_KERNEL=y
BR2_LINUX_KERNEL_CUSTOM_VERSION=y
BR2_LINUX_KERNEL_CUSTOM_VERSION_VALUE="5.4.77"
BR2_LINUX_KERNEL_USE_CUSTOM_CONFIG=y
BR2_LINUX_KERNEL_CUSTOM_CONFIG_FILE="$(BR2_EXTERNAL_MY_TEAM_PATH)/board/my-team/my-product/linux.config"
BR2_LINUX_KERNEL_INSTALL_TARGET=y
BR2_PACKAGE_UTIL_LINUX=y
BR2_TARGET_ROOTFS_CPIO=y
BR2_TARGET_ROOTFS_EXT2=y
BR2_TARGET_ROOTFS_EXT2_4=y
BR2_TARGET_ROOTFS_EXT2_LABEL="root"
BR2_TARGET_ROOTFS_EXT2_SIZE="3000M"
# BR2_TARGET_ROOTFS_TAR is not set
BR2_TARGET_GRUB2=y
BR2_TARGET_GRUB2_X86_64_EFI=y
BR2_PACKAGE_HOST_DOSFSTOOLS=y
BR2_PACKAGE_HOST_E2TOOLS=y
BR2_PACKAGE_HOST_EXFATPROGS=y
BR2_PACKAGE_HOST_GENEXT2FS=y
BR2_PACKAGE_HOST_GENIMAGE=y
BR2_PACKAGE_HOST_GPTFDISK=y
BR2_PACKAGE_HOST_MKPASSWD=y
BR2_PACKAGE_HOST_MTOOLS=y
BR2_ROOTFS_OVERLAY_DURING_POST_FAKEROOT_IS_ENABLED=y
BR2_ROOTFS_OVERLAY_DURING_POST_FAKEROOT_TARBALL_LIST="$(CONFIG_DIR)/../buildroot-output-rol.tar"
BR2_ROOTFS_OVERLAY_DEBOOTSTRAP_IS_ENABLED=y
BR2_ROOTFS_OVERLAY_DEBOOTSTRAP_SUITE="oldstable"
BR2_ROOTFS_OVERLAY_DEBOOTSTRAP_VARIANT="standard"
BR2_ROOTFS_OVERLAY_DEBOOTSTRAP_PACKAGE_INCLUSION_LIST="less,vim,emacs,sudo"
BR2_ROOTFS_OVERLAY_DEBOOTSTRAP_PACKAGE_EXCLUSION_LIST="emacs"
BR2_ROOTFS_OVERLAY_DEBOOTSTRAP_PACKAGE_INCLUSION_FILE_LIST="$(BR2_EXTERNAL_MY_TEAM_PATH)/board/my-team/my-product/rootfs-overlay.packages.included.txt"
BR2_ROOTFS_OVERLAY_DEBOOTSTRAP_PACKAGE_EXCLUSION_FILE_LIST="$(BR2_EXTERNAL_MY_TEAM_PATH)/board/my-team/my-product/rootfs-overlay.packages.excluded.txt"
BR2_CCACHE=y
```

## tests/trip-test/buildroot-ext-my-team/configs/my_team_product_x86_64_xctc_defconfig
```kconfig
BR2_x86_64=y
BR2_TOOLCHAIN_BUILDROOT_GLIBC=y
BR2_KERNEL_HEADERS_5_4=y
BR2_INIT_NONE=y
BR2_SYSTEM_BIN_SH_NONE=y
# BR2_PACKAGE_BUSYBOX is not set
# BR2_TARGET_ROOTFS_TAR is not set
```
